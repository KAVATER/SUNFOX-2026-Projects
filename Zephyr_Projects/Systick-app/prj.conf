## prj.conf
```kconfig
# Copyright (c) 2021 Nordic Semiconductor ASA
# SPDX-License-Identifier: Apache-2.0
#
# This file contains selected Kconfig options for the application.

CONFIG_GPIO=y
CONFIG_CONSOLE=y
CONFIG_PRINTK=y
CONFIG_INPUT=y
CONFIG_INPUT_GPIO_KEYS=y

CONFIG_DEBUG_THREAD_INFO=y
CONFIG_THREAD_NAME=y
CONFIG_NO_OPTIMIZATIONS=y
```

## src/main.c
```c
// in Zyphr you cant access systic as k_slee() already uses systick
//
//  k_msleep(500);
// The current thread goes to the sleep state.
// Zephyr keeps counting kernel ticks.
// After 500 ms, the scheduler wakes up the thread.
// The LED toggles again.
// 
// SysTick interrupt
//       ↓
// Kernel tick count increases
//       ↓
// k_msleep() checks elapsed time
//       ↓
// Thread wakes up
//       ↓
// Toggle LED
```
