## prj.conf
```kconfig
# Copyright (c) 2021 Nordic Semiconductor ASA
# SPDX-License-Identifier: Apache-2.0
#
# This file contains selected Kconfig options for the application.

CONFIG_GPIO=y
CONFIG_CONSOLE=y
CONFIG_PRINTK=y
CONFIG_INPUT=y
CONFIG_INPUT_GPIO_KEYS=y

CONFIG_DEBUG_THREAD_INFO=y
CONFIG_THREAD_NAME=y
CONFIG_NO_OPTIMIZATIONS=y
```

## src/main.c
```c
// code to blink led using timer
#include <zephyr/kernel.h>
#include <zephyr/drivers/gpio.h>
#include <zephyr/sys/printk.h>

#define LED_NODE DT_ALIAS(led0)

static const struct gpio_dt_spec led = GPIO_DT_SPEC_GET(LED_NODE,gpios);

//===== timer call back function =====

void timer_handler(struct k_timer *timer)
{
    static bool state = false;
    state = !state;
    gpio_pin_set_dt(&led, state);
}

K_TIMER_DEFINE(my_timer, timer_handler, NULL);

int main(void)
{
    if (!gpio_is_ready_dt(&led))
    {
        return 0;
    }
    gpio_pin_configure_dt(&led, GPIO_OUTPUT);

    gpio_pin_set_dt(&led, 0);

    k_timer_start(&my_timer, K_SECONDS(1), K_SECONDS(1));

    while (1)
    {
        k_sleep(K_FOREVER);
    }
}
```
